/dts-v1/;

#include "../qcom/kona.dtsi"
#include "kona.dtsi"

/ {
	model = "Qualcomm Technologies, Inc. kona v1 SoC";
	compatible = "qcom,kona";
	qcom,board-id = <0 0>;
	oplus,dtsi_no = <20061 20135 20161 20351 21615 21619 21623 21733>;
};
